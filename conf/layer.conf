## conf/layer.conf
```bitbake
# We have a conf and classes directory, append to BBPATH
BBPATH .= ":${LAYERDIR}"

# We have a recipes directory, add to BBFILES
BBFILES += "${LAYERDIR}/recipes*/*/*.bb ${LAYERDIR}/recipes*/*/*.bbappend ${LAYERDIR}/images/*.bb"

BBFILE_COLLECTIONS += "meta-atom"
BBFILE_PATTERN_meta-atom := "^${LAYERDIR}/"
BBFILE_PRIORITY_meta-atom = "16"

LAYERSERIES_COMPAT_meta-atom = "warrior"
```

## conf/local.conf.sample
```bitbake
# Local configuration for meta-atom images
# Supporting 32-bit Atom s10e netbooks
# Yocto Project 3.0 Poky distribution [zeus] branch
# This is a sysvinit system

# mask wireguard from meta-openembedded/meta-networking
# use version in meta-jumpnow to support kernels < 5.6
# with wireguard-linux-compat
BBMASK = "meta-networking/recipes-kernel/wireguard"

LICENSE_FLAGS_WHITELIST = "commercial"

DISTRO_FEATURES = "ext2 usbhost ${DISTRO_FEATURES_LIBC}"

# remove pulseaudio
DISTRO_FEATURES_BACKFILL_CONSIDERED += "pulseaudio"

PREFERRED_PROVIDER_jpeg = "libjpeg-turbo"

PREFERRED_PROVIDER_udev = "eudev"
VIRTUAL_RUNTIME_init_manager = "sysvinit"

MACHINE = "s10e"

PREFERRED_PROVIDER_virtual/kernel = "linux-stable"

# default version is 5.6, uncomment to change
#PREFERRED_VERSION_linux-stable = "5.4.%"

# uncomment for kernels < 5.6
# WIREGUARD_COMPAT = "1"

# DL_DIR = "/src/oe"
# SSTATE_DIR = "/oe9/atom/sstate-cache"
# TMPDIR = "/oe9/atom/tmp-zeus"

DISTRO = "poky"
PACKAGE_CLASSES = "package_ipk"
SDKMACHINE = "x86_64"

# for no root password
# EXTRA_IMAGE_FEATURES = "debug-tweaks"

# to set a root password
INHERIT += "extrausers"
EXTRA_USERS_PARAMS += "usermod -P jumpnowtek root;"

# to force a password change on first login
INHERIT += "chageusers"
CHAGE_USERS_PARAMS += "chage -d0 root;"

USER_CLASSES = "image-mklibs image-prelink"

PATCHRESOLVE = "noop"
RM_OLD_IMAGE = "1"
INHERIT += "rm_work"
CONF_VERSION = "1"
```

## conf/machine/atom32.conf
```bitbake
#@TYPE: Machine
#@NAME: atom32 

#@DESCRIPTION: Machine configuration for generic X86 (32-bit) PCs, particularly my Lenovo ideapad S10e. 

DEFAULTTUNE ?= "core2-32"
require conf/machine/include/tune-core2.inc
require conf/machine/include/atom-common.inc

SERIAL_CONSOLE = ""
```

## conf/machine/include/atom-common.inc
```bitbake
include conf/machine/include/x86-base.inc

MACHINE_FEATURES += "wifi pcbios"

PREFERRED_PROVIDER_virtual/kernel ?= "linux-stable"

MACHINE_EXTRA_RRECOMMENDS += "linux-firmware eee-acpi-scripts"

GLIBC_ADDONS = "nptl"
```

## conf/machine/s10e.conf
```bitbake
#@TYPE: Machine
#@NAME: S10e

#@DESCRIPTION: Machine configuration for Lenovo ideapad s10e netbooks 

DEFAULTTUNE ?= "core2-32"
require conf/machine/include/tune-core2.inc
require conf/machine/include/atom-common.inc

IMAGE_FSTYPES = "iso tar.xz"

SERIAL_CONSOLES = ""
```
